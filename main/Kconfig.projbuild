## main/Kconfig.projbuild
```kconfig
menu "Sensors App"

config WIFI_SSID
    string "WiFi SSID"

config WIFI_PASSWORD
    string "WiFi Password"

config WIFI_MAXIMUM_RETRY
    int "Maximum retry"
    default 5
    help
        Set the Maximum retry to avoid station reconnecting to the AP unlimited when the AP is really inexistent.

config HOST_IP_ADDR
    string "Host IP4 addresse"

config HOST_PORT
    int "Host port"

config SENSOR_READ_PERIOD_MS
    int "Sensors read periodicity in ms"
    default 20000

config SENSOR_PUBLISH_PERIOD_MS
    int "Sensors mqtt client publish periodicity in ms"
    default 120000

endmenu
```
